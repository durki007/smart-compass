## firmware/components/sc_compass/Kconfig
```kconfig
menu "HMC5883L I2C Compass"

    config I2C_SDA
        int "SDA pin"
        default 33
    config I2C_SCL
        int "SCL pin"
        default 32
    config COMPASS_AUTODETECT_ADDR
        bool "Autodetect compass address"
        default y
    config COMPASS_ADDR
        hex "Compass I2C address"
        default 0x0D
    config I2C_SCL_SPEED_HZ
        int "I2C SCL speed (Hz)"
        default 400000
    config COMPASS_AXIS_INDEX
        int "Compass axis index"
        help
            The index of the axis in the compass data. The default is 0, which
            means the compass data is in the X axis. If the compass data is in
            the Y axis, set this to 1. If the compass data is in the Z axis, set
            this to 2.
        default 0
    config COMPASS_REFRESH_PERIOD_MS
        int "Compass refresh period (ms)"
        default 10


endmenu
```

## firmware/sdkconfig.defaults
```kconfig
# Default configuration for ESP32 Smart Compass

#
# BT config
#
CONFIG_BT_ENABLED=y
CONFIG_BTDM_CTRL_MODE_BLE_ONLY=y
CONFIG_BTDM_CTRL_MODE_BR_EDR_ONLY=n
CONFIG_BTDM_CTRL_MODE_BTDM=n
CONFIG_BT_BLUEDROID_ENABLED=n
CONFIG_BT_NIMBLE_ENABLED=y

#
# LVGL configuration
#
CONFIG_LV_CONF_SKIP=y
CONFIG_LV_CONF_MINIMAL=y

#
# Color settings
#
# CONFIG_LV_COLOR_DEPTH_32 is not set
CONFIG_LV_COLOR_DEPTH_16=y
# CONFIG_LV_COLOR_DEPTH_8 is not set
# CONFIG_LV_COLOR_DEPTH_1 is not set
CONFIG_LV_COLOR_DEPTH=16
# CONFIG_LV_COLOR_16_SWAP is not set
# CONFIG_LV_COLOR_SCREEN_TRANSP is not set
CONFIG_LV_COLOR_MIX_ROUND_OFS=128
CONFIG_LV_COLOR_CHROMA_KEY_HEX=0x00FF00
# end of Color settings

#
# Memory settings
#
# CONFIG_LV_MEM_CUSTOM is not set
CONFIG_LV_MEM_SIZE_KILOBYTES=64
CONFIG_LV_MEM_ADDR=0x0
CONFIG_LV_MEM_BUF_MAX_NUM=16
# CONFIG_LV_MEMCPY_MEMSET_STD is not set
# end of Memory settings

#
# HAL Settings
#
CONFIG_LV_DISP_DEF_REFR_PERIOD=30
CONFIG_LV_INDEV_DEF_READ_PERIOD=30
# CONFIG_LV_TICK_CUSTOM is not set
CONFIG_LV_DPI_DEF=130
# end of HAL Settings

#
# Feature configuration
#

#
# Drawing
#
CONFIG_LV_DRAW_COMPLEX=y
CONFIG_LV_SHADOW_CACHE_SIZE=0
CONFIG_LV_CIRCLE_CACHE_SIZE=4
CONFIG_LV_LAYER_SIMPLE_BUF_SIZE=24576
CONFIG_LV_IMG_CACHE_DEF_SIZE=0
CONFIG_LV_GRADIENT_MAX_STOPS=2
CONFIG_LV_GRAD_CACHE_DEF_SIZE=0
# CONFIG_LV_DITHER_GRADIENT is not set
CONFIG_LV_DISP_ROT_MAX_BUF=10240
# end of Drawing

#
# Widget usage
#
CONFIG_LV_USE_CANVAS=y
CONFIG_LV_USE_IMG=y
CONFIG_LV_USE_LABEL=y
# end of Widget usage

#
# LVGL ESP Drivers
#

#
# LVGL TFT Display controller
#
CONFIG_LV_PREDEFINED_DISPLAY_NONE=y
# CONFIG_LV_PREDEFINED_DISPLAY_WROVER4 is not set
# CONFIG_LV_PREDEFINED_DISPLAY_M5STACK is not set
# CONFIG_LV_PREDEFINED_DISPLAY_M5CORE2 is not set
# CONFIG_LV_PREDEFINED_DISPLAY_M5STICK is not set
# CONFIG_LV_PREDEFINED_DISPLAY_M5STICKC is not set
# CONFIG_LV_PREDEFINED_DISPLAY_ERTFT0356 is not set
# CONFIG_LV_PREDEFINED_DISPLAY_ADA_FEATHERWING is not set
# CONFIG_LV_PREDEFINED_DISPLAY_RPI_MPI3501 is not set
# CONFIG_LV_PREDEFINED_DISPLAY_WEMOS_LOLIN is not set
# CONFIG_LV_PREDEFINED_DISPLAY_ATAG is not set
# CONFIG_LV_PREDEFINED_DISPLAY_RPI_RA8875 is not set
# CONFIG_LV_PREDEFINED_DISPLAY_TTGO is not set
# CONFIG_LV_PREDEFINED_DISPLAY_TTGO_CAMERA_PLUS is not set
# CONFIG_LV_PREDEFINED_DISPLAY_WT32_SC01 is not set
CONFIG_LV_TFT_DISPLAY_CONTROLLER_ST7735S=y
CONFIG_LV_TFT_DISPLAY_PROTOCOL_SPI=y
CONFIG_LV_HOR_RES_MAX=128
CONFIG_LV_VER_RES_MAX=160
CONFIG_LV_DISPLAY_ORIENTATION_PORTRAIT=y
# CONFIG_LV_DISPLAY_ORIENTATION_PORTRAIT_INVERTED is not set
# CONFIG_LV_DISPLAY_ORIENTATION_LANDSCAPE is not set
# CONFIG_LV_DISPLAY_ORIENTATION_LANDSCAPE_INVERTED is not set
CONFIG_LV_DISPLAY_ORIENTATION=0
# CONFIG_LV_PREDEFINED_PINS_NONE is not set
CONFIG_LV_PREDEFINED_PINS_38V4=y
# CONFIG_LV_PREDEFINED_PINS_30 is not set
# CONFIG_LV_PREDEFINED_PINS_38V1 is not set
# CONFIG_LV_PREDEFINED_PINS_TKOALA is not set
# CONFIG_LV_TFT_DISPLAY_USER_CONTROLLER_ILI9341 is not set
# CONFIG_LV_TFT_DISPLAY_USER_CONTROLLER_ILI9481 is not set
# CONFIG_LV_TFT_DISPLAY_USER_CONTROLLER_ILI9486 is not set
# CONFIG_LV_TFT_DISPLAY_USER_CONTROLLER_ILI9488 is not set
# CONFIG_LV_TFT_DISPLAY_USER_CONTROLLER_ST7789 is not set
# CONFIG_LV_TFT_DISPLAY_USER_CONTROLLER_ST7796S is not set
# CONFIG_LV_TFT_DISPLAY_USER_CONTROLLER_GC9A01 is not set
CONFIG_LV_TFT_DISPLAY_USER_CONTROLLER_ST7735S=y
# CONFIG_LV_TFT_DISPLAY_USER_CONTROLLER_HX8357 is not set
# CONFIG_LV_TFT_DISPLAY_USER_CONTROLLER_SH1107 is not set
# CONFIG_LV_TFT_DISPLAY_USER_CONTROLLER_SSD1306 is not set
# CONFIG_LV_TFT_DISPLAY_USER_CONTROLLER_FT81X is not set
# CONFIG_LV_TFT_DISPLAY_USER_CONTROLLER_IL3820 is not set
# CONFIG_LV_TFT_DISPLAY_USER_CONTROLLER_JD79653A is not set
# CONFIG_LV_TFT_DISPLAY_USER_CONTROLLER_UC8151D is not set
# CONFIG_LV_TFT_DISPLAY_USER_CONTROLLER_RA8875 is not set
# CONFIG_LV_TFT_DISPLAY_USER_CONTROLLER_ILI9163C is not set
# CONFIG_LV_TFT_DISPLAY_USER_CONTROLLER_PCD8544 is not set
# CONFIG_CUSTOM_DISPLAY_BUFFER_SIZE is not set
CONFIG_LV_TFT_DISPLAY_SPI2_HOST=y
# CONFIG_LV_TFT_DISPLAY_SPI3_HOST is not set
CONFIG_LV_TFT_DISPLAY_SPI_TRANS_MODE_SIO=y
# CONFIG_LV_TFT_DISPLAY_SPI_TRANS_MODE_DIO is not set
# CONFIG_LV_TFT_DISPLAY_SPI_TRANS_MODE_QIO is not set
CONFIG_LV_TFT_DISPLAY_SPI_HALF_DUPLEX=y
# CONFIG_LV_TFT_DISPLAY_SPI_FULL_DUPLEX is not set
# CONFIG_LV_TFT_USE_CUSTOM_SPI_CLK_DIVIDER is not set
CONFIG_LV_TFT_CUSTOM_SPI_CLK_DIVIDER=2
# CONFIG_LV_M5STICKC_HANDLE_AXP192 is not set
# CONFIG_LV_INVERT_COLORS is not set

#
# Display Pin Assignments
#
CONFIG_LV_DISP_SPI_MOSI=23
# CONFIG_LV_DISPLAY_USE_SPI_MISO is not set
CONFIG_LV_DISP_SPI_CLK=18
CONFIG_LV_DISPLAY_USE_SPI_CS=y
CONFIG_LV_DISP_SPI_CS=5
CONFIG_LV_DISPLAY_USE_DC=y
CONFIG_LV_DISP_PIN_DC=2
CONFIG_LV_DISP_USE_RST=y
CONFIG_LV_DISP_PIN_RST=4
CONFIG_LV_DISP_PIN_BUSY=35
# end of Display Pin Assignments

CONFIG_LV_DISP_BACKLIGHT_OFF=y
# CONFIG_LV_DISP_BACKLIGHT_SWITCH is not set
# CONFIG_LV_DISP_BACKLIGHT_PWM is not set
CONFIG_LV_I2C_DISPLAY_PORT=0
# end of LVGL TFT Display controller
# end of LVGL ESP Drivers
```
